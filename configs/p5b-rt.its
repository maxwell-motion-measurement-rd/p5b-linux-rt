## configs/p5b-rt.its
```
/dts-v1/;
/ {
    description = "P5B Linux 5.4.0 PREEMPT_RT, A53 Core0-2, initramfs";
    #address-cells = <1>;
    images {
        kernel@1 {
            description = "P5B RT Linux kernel";
            data = /incbin/("../arch/arm64/boot/Image.gz");
            type = "kernel"; arch = "arm64"; os = "linux";
            compression = "gzip"; load = <0x80000>; entry = <0x80000>;
            hash@1 { algo = "sha256"; };
        };
        fdt@system-top.dtb {
            description = "P5B Linux Core0-2 device tree";
            data = /incbin/("../dtb/system.dtb");
            type = "flat_dt"; arch = "arm64"; compression = "none";
            hash@1 { algo = "sha256"; };
        };
        ramdisk@1 {
            description = "P5B initramfs with matching RT modules";
            data = /incbin/("../../staging/rootfs.cpio.gz");
            type = "ramdisk"; arch = "arm64"; os = "linux"; compression = "none";
            hash@1 { algo = "sha256"; };
        };
    };
    configurations {
        default = "conf@system-top.dtb";
        conf@system-top.dtb {
            description = "RT kernel, three-core FDT, initramfs";
            kernel = "kernel@1"; fdt = "fdt@system-top.dtb"; ramdisk = "ramdisk@1";
        };
    };
};
```
